## drivers/i2c/chips/Kconfig
```kconfig
#
# Miscellaneous I2C chip drivers configuration
#
# *** DEPRECATED! Do not add new entries! See Makefile ***
#

menu "Miscellaneous I2C Chip support"

config SENSORS_MT9T013
	tristate "MT9T013 Camera Driver"
	depends on I2C
	default y
	help
	 MT9T013 Camera Driver implemented by HTC.

config OPTICAL_GP2A
	depends on I2C
	tristate "GP2A driver"
	default y
	help
	  This option enables proximity & light sensors using gp2a driver.

config SENSORS_YDA165
	bool "YDA165 Audio Amp Driver"
	depends on I2C
	default y
	help
	 YDA165 Audio AMP

config SENSORS_YDA160
	bool "YDA160 Audio Amp Driver"
	depends on I2C
	default y
	help
	 YDA165 Audio AMP

config SENSORS_MAX9879
	bool "MAX9879 Audio Amp Driver"
	depends on I2C
	default y 
	help
	 MAXIM 9879 Audio AMP	 

config USB_SWITCH_FSA9480
	tristate "FSA9480 Micro USB Switch IC Driver"
	depends on I2C
	default n
	help
	 FSA9480 Micro USB Switch IC Driver

config SENSORS_YAS529_MAGNETIC
	tristate "Yamaha YAS529 Geomagnetic Sensor"
	depends on I2C

config INPUT_YAS529_POSITION
	int "YAS529 Mounting Position on Board"
	depends on SENSORS_YAS529_MAGNETIC
	default "0"
	help
	  Chip mounting position (pin 1).
	    0: top, upper-left
	    1: top, upper-right
	    2: top, lower-right
	    3: top, lower-left
	    4: bottom, upper-left
	    5: bottom, upper-right
	    6: bottom, lower-right
	    7: bottom, lower-left

config WM8994_AMP
	bool "WM8994 Audio Amp Driver"
	depends on I2C
	default y
	help
	 WM8994 Audio AMP

config WM8994_KOR_E140S
	bool "E140S WM8994"
	depends on I2C
	default n

config WM8994_KOR_E140L
	bool "E140S WM8994"
	depends on I2C
	default n

endmenu
```
